## sdkconfig.defaults
```kconfig
CONFIG_IDF_TARGET="esp32p4"

# Enable SPIRAM
CONFIG_SPIRAM=y
CONFIG_SPIRAM_SPEED_200M=y
CONFIG_SPIRAM_XIP_FROM_PSRAM=y
CONFIG_SPIRAM_MEMTEST=n

# Enable GDBStub
CONFIG_ESP_SYSTEM_PANIC_GDBSTUB=y

# Enable FreeRTOS trace
CONFIG_FREERTOS_USE_TRACE_FACILITY=y
CONFIG_FREERTOS_VTASKLIST_INCLUDE_COREID=y
CONFIG_FREERTOS_GENERATE_RUN_TIME_STATS=y
CONFIG_FREERTOS_HZ=1000

# Support 2 SNTP
CONFIG_LWIP_SNTP_MAX_SERVERS=2

# Enable DTLS SRTP
CONFIG_MBEDTLS_SSL_PROTO_DTLS=y
CONFIG_MBEDTLS_SSL_DTLS_SRTP=y

# Use new I2C master
CONFIG_CODEC_I2C_BACKWARD_COMPATIBLE=n

# Enable experimental features
CONFIG_IDF_EXPERIMENTAL_FEATURES=y

# Use customer partition table
CONFIG_PARTITION_TABLE_CUSTOM=y

#
# HTTP Server
#
CONFIG_HTTPD_MAX_REQ_HDR_LEN=4096
CONFIG_HTTPD_MAX_URI_LEN=256
CONFIG_HTTPD_SERVER_EVENT_POST_TIMEOUT=100

# Allocate LWIP and MbedTLS on SPIRAM
CONFIG_SPIRAM_MALLOC_ALWAYSINTERNAL=256
CONFIG_SPIRAM_TRY_ALLOCATE_WIFI_LWIP=y
CONFIG_MBEDTLS_EXTERNAL_MEM_ALLOC=y

# Flash setting
CONFIG_FLASHMODE_QIO=y
CONFIG_ESPTOOLPY_FLASHSIZE_16MB=y
CONFIG_SPI_FLASH_SUPPORT_GD_CHIP=y

CONFIG_SPIRAM_SPEED_200M=y

# If you use serial JTAG turn on this option
#CONFIG_ESP_CONSOLE_USB_SERIAL_JTAG=y

# Use camera SC2336
CONFIG_CAMERA_SC2336=y
CONFIG_CAMERA_SC2336_MIPI_RAW10_1920x1080_25FPS_2_LANE=y

# Use camera OV5647
CONFIG_CAMERA_OV5647=y
CONFIG_CAMERA_OV5647_MIPI_RAW10_1920x1080_30FPS=y

# Enable ISP pipelines
CONFIG_ESP_VIDEO_ENABLE_ISP_PIPELINE_CONTROLLER=y

# Set Slave target type
CONFIG_IDF_SLAVE_TARGET="esp32c6"
CONFIG_SLAVE_IDF_TARGET_ESP32C6=y

# Enable following configuration if support C5 Slave, make sure GPIO matched
# CONFIG_SLAVE_IDF_TARGET_ESP32C5=y
# CONFIG_ESP_HOSTED_SPI_HD_HOST_INTERFACE=y
# CONFIG_ESP_SPI_HD_GPIO_CS=4
# CONFIG_ESP_SPI_HD_GPIO_CLK=5
# CONFIG_ESP_SPI_HD_GPIO_D0=20
# CONFIG_ESP_SPI_HD_GPIO_D1=21
# CONFIG_ESP_SPI_HD_GPIO_D2=22
# CONFIG_ESP_SPI_HD_GPIO_D3=23
# CONFIG_ESP_SPI_HD_GPIO_DATA_READY=32
# CONFIG_ESP_SPI_HD_GPIO_RESET_SLAVE=33
# CONFIG_ESP_SPI_HD_FREQ_ESP32XX=40
# CONFIG_ESP_HOSTED_SPI_HD_PRIV_INTERFACE_4_DATA_LINES=y
```
